## ipcamera/build/module/Kconfig
```kconfig
menu "module options"

comment "Select module functions"


config MODULE_MEDIA
	bool "enable module media"
	default y
	help
		enable media in applicant

config MODULE_MEDIA_SYS
	bool "enable module media sys"
	default y
	depends on MODULE_MEDIA
	help
		enable media sys in applicant

config MODULE_MEDIA_VI
	bool "enable module media vi"
	default y
	depends on MODULE_MEDIA
	help
		enable media vi in applicant

config MODULE_MEDIA_VPSS
	bool "enable module media vpss"
	default y
	depends on MODULE_MEDIA
	help
		enable media vpss in applicant

config MODULE_MEDIA_VENC
	bool "enable module media venc"
	default y
	depends on MODULE_MEDIA
	help
		enable media venc in applicant

config MODULE_MEDIA_VO
	bool "enable module media vo"
	default n
	depends on MODULE_MEDIA
	help
		enable media vo in applicant

config MODULE_MEDIA_DEC
	bool "enable module vdec(hard)"
	default n
	depends on MODULE_MEDIA
	help
		enable media vdec in applicant

config MODULE_MEDIA_OSD
	bool "enable module media osd"
	depends on MODULE_MEDIA
	default n
	help
		enable media osd in applicant

config MODULE_MEDIA_AUDIO
	bool "enable module audio"
	default n
	depends on MODULE_MEDIA
	help
		enable audio in applicant

config MODULE_AUDIO_MP3
	bool "enable module audio mp3"
	default n
	depends on MODULE_MEDIA_AUDIO && MODULE_MEDIA
	help
		enable audio mp3 in applicant

config MODULE_PROTOCOL
	bool "enable module protocol"
	default n
	help
		enable protocol in applicant

config MODULE_CVIUAC
	bool "enale module uac"
	default n
	select MODULE_PROTOCOL
	help 
		enable uac in applicant

config MODULE_CVIUVC
	bool "enale module uvc"
	default n
	depends on !MODULE_CVIUVC_HOST
	select MODULE_PROTOCOL
	help 
		enable uvc in applicant

config MODULE_CVIUVC_HOST
	bool "enale module uvc host"
	default n
	select MODULE_PROTOCOL
	help
		enable uvc host in applicant

config MODULE_MEDIA_MSG
	bool "enale module msg"
	default n
	depends on MODULE_MEDIA
	help
		enable msg in applicant

config MODULE_MEDIA_EFUSE
	bool "enale module efuse"
	default n
	depends on MODULE_MEDIA
	help
		enable efuse in applicant

config MODULE_MEDIA_ANONMSG
	bool "enale module ipcm anonymous"
	default n
	depends on MODULE_MEDIA
	help
		enable ipcm anonymous in applicant

config MODULE_NETWORK
	bool "enable module network"
	default n
	select MODULE_PROTOCOL
	help 
		enable network in appllicant, support web

config MODULE_RTSP
	bool "enable module rtsp"
	default n
	depends on MODULE_MEDIA && MODULE_MBUF 
	select MODULE_PROTOCOL
	help
		enable rtsp in applicant

config RTSP_AUDIO_ENABLE
	bool "enable rtsp audio stream"
	default n
	depends on MODULE_RTSP && MODULE_MEDIA_AUDIO
	help
		enable audio streaming for rtsp when audio module is enabled

config MODULE_OTA
	bool "enable module ota"
	default n
	select MODULE_PROTOCOL
	help 
		enable ota in appllicant

config MODULE_DISPLAY
	bool "enable module display"
	default n
	help
		enable display in applicant

config MODULE_AI
	bool "enable module ai"
	default n
	help
		enable ai in applicant

config MODULE_AI_MD
	bool "enable module ai md"
	default n
	depends on MODULE_AI
	help
		enable ai motion detect in applicant

config MODULE_AI_PD
	bool "enable module ai pd"
	default n
	depends on MODULE_AI
	help
		enable ai people detect in applicant

config MODULE_AI_FD_FACE
	bool "enable module ai fd face"
	default n
	depends on MODULE_AI
	help
		enable ai face detect in applicant
	
config MODULE_AI_IRFAECE
	bool "enable module ai ir face detect"
	default n
	depends on MODULE_AI
	help
		enable ai ir face detect in applicant

config MODULE_AI_BABYCRY
	bool "enable module ai babycry"
	default n
	depends on MODULE_AI
	help
		enable ai babycry in applicant

config MODULE_AI_HUMAN_KEYPOINT
	bool "enable module ai human keypoint detect"
	default n
	depends on MODULE_AI
	help
		enable ai human keypoint detect in applicant

config MODULE_AI_OBJECT_TRACK
	bool "enable module ai object tracking"
	default n
	depends on MODULE_AI
	help
		enable ai object tracking in applicant
		
config MODULE_AI_KEYPOINT_HAND_GESTURE
	bool "enable module ai keypoint hand gesture detect"
	default n
	depends on MODULE_AI
	help
		enable ai keypoint hand gesture detect in applicant

config MODULE_AI_IMG_TXT_CLIP
	bool "enable module ai img txt clip"
	default n
	depends on MODULE_AI
	help
		enable ai img txt clip in applicant

config MODULE_AI_LPR
	bool "enable module ai lpr"
	default n
	depends on MODULE_AI
	help
		enable ai license plate recognition in applicant
config MODULE_PERIPHERAL
	bool "enable module peripheral"
	default n
	help
		enable peripheral in applicant

config MODULE_ADC
	bool "enable module adc"
	default n
	depends on MODULE_PERIPHERAL
	help
		enable adc peripheral in applicant

config MODULE_GPIO
	bool "enable module gpio"
	default n
	depends on MODULE_PERIPHERAL
	help
		enable gpio peripheral in applicant

config MODULE_IRCUT
	bool "enable module ircut"
	default n
	depends on MODULE_PERIPHERAL
	help
		enable ircut peripheral in applicant

config MODULE_PWM
	bool "enable module pwm"
	default n
	depends on MODULE_PERIPHERAL
	help
		enable pwm peripheral in applicant

config MODULE_PQTOOL
	bool "enable module pqtool"
	default n
	depends on MODULE_MEDIA
	help
		enable pqtool in applicant

config MODULE_RECORD
	bool "enable module record"
	default n
	help
		enable record in applicant

config MODULE_COMMON
	bool "enable module common"
	default y
	help
		enable common in applicant

config MODULE_PARAMPARSE
	bool "enable module paramprase"
	default y
	depends on MODULE_COMMON && MODULE_MININI
	help
		enable paramprase in applicant

config MODULE_CJSON
	bool "eanble module cjson"
	default n
	depends on MODULE_COMMON
	help
		enable cjson in applicant

config MODULE_MININI
	bool "eanble module minini"
	default n
	depends on MODULE_COMMON
	help
		enable minini in applicant

config MODULE_MBUF
	bool "eanble module mbuf"
	default n
	depends on MODULE_COMMON
	help
		enable mbuf in applicant

endmenu
```

## ipcamera/build/resource/Kconfig
```kconfig
menu "resource options"

config RESOURCE_INSTALL_BITMAP
	bool "install tiger.bmp"
	default n
	help
		"support install tiger.bmp"

config RESOURCE_INSTALL_VDEC_FILES
	bool "install 640x360.jpg"
	default n
	help
		"support install 640x360.jpg"

menu "ai models resource"

menu "CV184X"

config RESOURCE_INSTALL_YOLOV8N_DET_PERSON_VEHICLE
	bool "install yolov8n_det_person_vehicle"
	default n
	help
		"support install yolov8n_det_person_vehicle"

config RESOURCE_INSTALL_YOLO11_PERSON_VEHICLE
	bool "install yolo11_person_vehicle"
	default n
	help
		"support install yolo11_person_vehicle"

config RESOURCE_INSTALL_TRACKING_FEARTACK
	bool "install tracking_feartrack"
	default n
	help
		"support install tracking_feartrack"

config RESOURCE_INSTALL_FASTSAM_SEG
	bool "install fastsam_seg"
	default n
	help
		"support install fastsam_seg"

config RESOURCE_INSTALL_CLIP_IMG
	bool "install clip image"
	default n
	help
		"support install clip image"

config RESOURCE_INSTALL_CLIP_TXT
	bool "install clip txt"
	default n
	help
		"support install clip txt"

endmenu

endmenu

menu "file recover"

config RESOURCE_INSTALL_H264_PCM_TEMPLATE
	bool "install h264 pcm template"
	default n
	help
		"support install record h264 & pcm fix file"

config RESOURCE_INSTALL_H265_PCM_TEMPLATE
	bool "install h265 pcm template"
	default n
	help
		"support install record h265 & pcm fix file"

config RESOURCE_INSTALL_MP4_AAC_TEMPLATE
	bool "install mp4 aac template"
	default n
	help
		"support install record mp4 & aac fix file"

endmenu

config RESOURCE_INSTALL_NETWORK_WWW
	bool "install www"
	default n
	help
		"support install www for websock"

menu "param resource"

menu "fbm"

config RESOURCE_INSTALL_FBM_CV1842HP_WEVB_CV2003
	bool "install fbm cv1842hp_wevb_cv2003"
	default n
	help
		"support install cv1842hp_wevb_cv2003.ini"

config RESOURCE_INSTALL_FBM_CV1842HP_WEVB_CV2003_MIPI_SWITCH
	bool "install fbm cv1842hp_wevb_cv2003_mipi_switch"
	default n
	help
		"support install fbm cv1842hp_wevb_cv2003_mipi_switch.ini"

config RESOURCE_INSTALL_FBM_CV1843HP_WEVB_OS04A10
	bool "install fbm cv1843hp_wevb_os04a10"
	default n
	help
		"support install fbm cv1843hp_wevb_os04a10.ini"


endmenu

menu "sbm"

endmenu

endmenu

endmenu
```

## ipcamera/build/toolchain/Kconfig
```kconfig
menu "cross_compile options"

choice
	prompt "cross_compile"
	default TOOLCHAIN_MUSL_RISCV64

config TOOLCHAIN_GLIBC_RISCV64
	bool "riscv glibc toolchain 64bit"
	help
	  glibc library for riscv64(RISCV64).

config TOOLCHAIN_MUSL_RISCV64
	bool "riscv musl toolchain 64bit"
	help
	  musl library for riscv64(RISCV64).
	  select on compiler option through menuconfig
	  default value is false.

config TOOLCHAIN_MUSL_32BIT_ARM
	bool "arm musl toolchain 32bit"
	help
	  musl library for arm(arm32).
	  select on compiler option through menuconfig
	  default value is false.

config TOOLCHAIN_GLIBC_32BIT_ARM
	bool "arm glibc toolchain 32bit"
	help
	  glibc library for arm(arm32)

config TOOLCHAIN_GLIBC_64BIT_ARM
	bool "arm glibc 64bit toolchain 64bit"
	help
	  glibc library for arm(arm64)


endchoice

config CROSS_COMPILE
	string
	default "riscv64-unknown-linux-gnu-" if TOOLCHAIN_GLIBC_RISCV64
	default "riscv64-unknown-linux-musl-" if TOOLCHAIN_MUSL_RISCV64
	default "arm-none-linux-gnueabihf-" if TOOLCHAIN_GLIBC_32BIT_ARM
	default "aarch64-none-linux-gnu-" if TOOLCHAIN_GLIBC_64BIT_ARM
	default "arm-none-linux-musleabihf-" if TOOLCHAIN_MUSL_32BIT_ARM
	help
	  Cross compile toolchain.

endmenu
```

## ipcamera/configs/cv184x_ovis_app_defconfig
```kconfig
CONFIG_TOOLCHAIN_MUSL_32BIT_ARM=y
CONFIG_CROSS_COMPILE="arm-none-linux-musleabihf-"
CONFIG_STATIC_COMPILER_SUPPORT=y
CONFIG_SDK_DIR=""
CONFIG_MODULE_MEDIA_AUDIO=n
CONFIG_MODULE_AUDIO_MP3=n
CONFIG_MODULE_MEDIA=y
CONFIG_MODULE_MEDIA_SYS=y
CONFIG_MODULE_MEDIA_VI=y
CONFIG_MODULE_MEDIA_VPSS=y
CONFIG_MODULE_MEDIA_VENC=y
CONFIG_MODULE_MEDIA_OSD=y
CONFIG_MODULE_MEDIA_DEC=n
CONFIG_MODULE_MEDIA_VO=n
CONFIG_MODULE_MEDIA_MSG=n
CONFIG_MODULE_MEDIA_ANONMSG=n
CONFIG_MODULE_DISPLAY=n
CONFIG_MODULE_NETWORK=n
CONFIG_MODULE_PERIPHERAL=y
CONFIG_MODULE_ADC=y
CONFIG_MODULE_GPIO=y
CONFIG_MODULE_IRCUT=y
CONFIG_MODULE_PWM=y
CONFIG_MODULE_PROTOCOL=y
CONFIG_MODULE_RTSP=y
CONFIG_RTSP_AUDIO_ENABLE=y
CONFIG_MODULE_PQTOOL=y
CONFIG_MODULE_OTA=n
CONFIG_MODULE_AI=y
CONFIG_MODULE_AI_BNR=y
CONFIG_MODULE_AI_MD=y
CONFIG_MODULE_AI_PD=y
CONFIG_MODULE_AI_IRFAECE=n
CONFIG_MODULE_AI_FD_FACE=y
CONFIG_MODULE_AI_BABYCRY=n
CONFIG_MODULE_AI_HUMAN_KEYPOINT=y
CONFIG_MODULE_AI_OBJECT_TRACK=y
CONFIG_MODULE_AI_KEYPOINT_HAND_GESTURE=n
CONFIG_MODULE_AI_IMG_TXT_CLIP=n
CONFIG_MODULE_AI_LPR=n
CONFIG_MODULE_COMMON=y
CONFIG_MODULE_PARAMPARSE=y
CONFIG_MODULE_CJSON=y
CONFIG_MODULE_MININI=y
CONFIG_MODULE_MBUF=y
CONFIG_MODULE_RECORD=n
CONFIG_MODULE_CVIUVC=y
CONFIG_RESOURCE_INSTALL_BITMAP=y
CONFIG_RESOURCE_INSTALL_TEAISP_BNR_MODEL=y
CONFIG_RESOURCE_INSTALL_NETWORK_WWW=y
CONFIG_RESOURCE_INSTALL_YOLOV8N_DET_MONITOR_PERSON=y
CONFIG_RESOURCE_INSTALL_SCRFD_DET_FACE=y
CONFIG_RESOURCE_INSTALL_KEYPOINT_YOLOV8POSE_PERSON17=y
CONFIG_RESOURCE_INSTALL_TRACKING_FEARTACK=y
CONFIG_RESOURCE_INSTALL_FASTSAM_SEG=y
CONFIG_RESOURCE_INSTALL_YOLOV8N_DET_PERSON_VEHICLE=y
CONFIG_RESOURCE_INSTALL_YOLO11_PERSON_VEHICLE=n
CONFIG_RESOURCE_INSTALL_CLIP_IMG=n
CONFIG_RESOURCE_INSTALL_CLIP_TXT=n
CONFIG_RESOURCE_INSTALL_SBM_CV1842HP_CV2003=n
CONFIG_RESOURCE_INSTALL_SBM_CV1842HP_OVIS_SC235HAI=y
```

## ovis-manager/configs/cv1842hp_ovis_spinand_defconfig
```kconfig
CONFIG_OVIS_MANAGER_PORT=8080
CONFIG_OVIS_MANAGER_BIND_ADDRESS=192.168.42.1
CONFIG_OVIS_MANAGER_ALLOWED_ORIGIN=https://ovis.aimorelogy.com
CONFIG_OVIS_MANAGER_DEV_ORIGIN=http://localhost:5173
CONFIG_OVIS_MANAGER_DEV_ORIGIN_ALT=http://127.0.0.1:5173
CONFIG_OVIS_FIRMWARE_VERSION=1.0.0
CONFIG_OVIS_AI_BNR=y
CONFIG_OVIS_AI_BNR_CERTIFIED=y
```

## ramdisk/rootfs/public/adbd/Kconfig
```kconfig
config TARGET_PACKAGE_ADBD
	bool "Target package adbd"
	default n
	help
	  target adbd
```

## ramdisk/rootfs/public/dhcpcd/Kconfig
```kconfig
config TARGET_PACKAGE_DHCPCD
	bool "Target package dhcpcd"
	default n
	help
	  target dhcpcd
```

## ramdisk/rootfs/public/dropbear/Kconfig
```kconfig
config TARGET_PACKAGE_DROPBEAR
	bool "Target package dropbear"
	default y
	help
	  target dropbear
```

## ramdisk/rootfs/public/evtest/Kconfig
```kconfig
config TARGET_PACKAGE_EVTEST
	bool "Target package evtest"
	default n
	help
	source code:ramdisk/tools/evtest
```

## ramdisk/rootfs/public/ncm/Kconfig
```kconfig
config TARGET_PACKAGE_NCM_SCRIPT
	bool "Target package NCM startup script"
	default n
	help
	  Start a USB CDC NCM gadget and configure usb0 with a static address.
```

## ramdisk/rootfs/public/ntp/Kconfig
```kconfig
config TARGET_PACKAGE_NTP
	bool "Target package ntp"
	default y
	help
	ntp version: 4.2.8p15
```

## ramdisk/rootfs/public/openssh/Kconfig
```kconfig
config TARGET_PACKAGE_OPENSSH
	bool "Target package openssh"
	select TARGET_PACKAGE_OPENSSL
	select TARGET_PACKAGE_LIBZ
	depends on !TARGET_PACKAGE_DROPBEAR
	default n
	help
	  target openssh
```

## ramdisk/rootfs/public/openssl/Kconfig
```kconfig
config TARGET_PACKAGE_OPENSSL
	bool "Target package openssl"
	default y
	help
	  target package openssl
```

## ramdisk/rootfs/public/rsyslog/Kconfig
```kconfig
config TARGET_PACKAGE_RSYSLOG
	bool "Target package rsyslog"
	default n
	help
	  target package rsyslog
```

## ramdisk/rootfs/public/umtprd/Kconfig
```kconfig
config TARGET_PACKAGE_UMTPRD
	bool "Target package umtprd"
	default n
	help
		Target package umtprd
```

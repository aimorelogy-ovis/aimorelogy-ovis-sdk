## rt-thread/bsp/cvitek/cv18xx_boot/Kconfig
```kconfig
mainmenu "RT-Thread Project Configuration"

BSP_DIR := .

RTT_DIR := ../../..

PKGS_DIR := packages

source "$(RTT_DIR)/Kconfig"
osource "$PKGS_DIR/Kconfig"
rsource "board/Kconfig"

config BSP_USING_CV18XX
    bool
    select ARCH_RISCV64
    select ARCH_USING_RISCV_COMMON64
    default y
#    select RT_USING_USER_MAIN
config C906_PLIC_PHY_ADDR
    hex
    default 0x70000000

config IRQ_MAX_NR
    int
    default 101

config BSP_GPIO_IRQ_BASE
    int
    default 60

config BSP_SYS_GPIO_IRQ_BASE
    int
    default 70

config __STACKSIZE__
    int "stack size for interrupt"
    default 4096

config SOC_TYPE_CV180XB_QFN
    bool
    default n

config SOC_TYPE_CV181XC_QFN
    bool
    default n

config SOC_TYPE_CV181XH_BGA
    bool
    default n

choice
    prompt "Board Type"
    default BOARD_TYPE_CV1810C_WEVB_0006A_SPINOR

    config BOARD_TYPE_CV180ZB_WEVB_0008A_SPINOR
        select SOC_TYPE_CV180XB_QFN
        bool "cv180zb_wevb_0008a_spinor"

    config BOARD_TYPE_CV1810C_WEVB_0006A_SPINOR
        select SOC_TYPE_CV181XC_QFN
        bool "cv1810c_wevb_0006a_spinor"

    config BOARD_TYPE_MILKV_DUO
        select SOC_TYPE_CV180XB_QFN
        bool "milkv-duo"

    config BOARD_TYPE_MILKV_DUO_SPINOR
        select SOC_TYPE_CV180XB_QFN
        bool "milkv-duo-spinor"

    config BOARD_TYPE_MILKV_DUO256M
        select SOC_TYPE_CV181XC_QFN
        bool "milkv-duo256m"

    config BOARD_TYPE_MILKV_DUO256M_SPINOR
        select SOC_TYPE_CV181XC_QFN
        bool "milkv-duo256m-spinor"

    config BOARD_TYPE_MILKV_DUOS
        select SOC_TYPE_CV181XH_BGA
        bool "milkv-duos"

endchoice
```

## rt-thread/bsp/cvitek/cv18xx_risc-v/Kconfig
```kconfig
mainmenu "RT-Thread Project Configuration"

BSP_DIR := .

RTT_DIR := ../../..

PKGS_DIR := packages

source "$(RTT_DIR)/Kconfig"
osource "$PKGS_DIR/Kconfig"
rsource "board/Kconfig"

config BSP_USING_CV18XX
    bool
    select ARCH_RISCV64
    select ARCH_RISCV_FPU_D
    select ARCH_USING_RISCV_COMMON64
    select RT_USING_SYSTEM_WORKQUEUE
    select RT_USING_COMPONENTS_INIT
    select RT_USING_USER_MAIN
    select RT_USING_CACHE
    select ARCH_MM_MMU
    select RT_USING_DEVICE_OPS
    select ARCH_REMAP_KERNEL if RT_USING_SMART
    default y

config C906_PLIC_PHY_ADDR
    hex
    default 0x70000000

config IRQ_MAX_NR
    int
    default 101

config BSP_GPIO_IRQ_BASE
    int
    default 60

config BSP_SYS_GPIO_IRQ_BASE
    int
    default 70

config __STACKSIZE__
    int "stack size for interrupt"
    default 4096


config SOC_TYPE_CV180XB_QFN
    bool
    default n

config SOC_TYPE_CV181XC_QFN
    bool
    default n

config SOC_TYPE_CV181XH_BGA
    bool
    default n

choice
    prompt "Board Type"
    default BOARD_TYPE_MILKV_DUO256M

    config BOARD_TYPE_MILKV_DUO
        select SOC_TYPE_CV180XB_QFN
        bool "milkv-duo"

    config BOARD_TYPE_MILKV_DUO_SPINOR
        select SOC_TYPE_CV180XB_QFN
        bool "milkv-duo-spinor"

    config BOARD_TYPE_MILKV_DUO256M
        select SOC_TYPE_CV181XC_QFN
        bool "milkv-duo256m"

    config BOARD_TYPE_MILKV_DUO256M_SPINOR
        select SOC_TYPE_CV181XC_QFN
        bool "milkv-duo256m-spinor"

    config BOARD_TYPE_MILKV_DUOS
        select SOC_TYPE_CV181XH_BGA
        bool "milkv-duos"

endchoice

choice BSP_ROOTFS_TYPE
    prompt "rootfs type"
    default BSP_ROOTFS_TYPE_DISKFS

    config BSP_ROOTFS_TYPE_DISKFS
        bool "Disk FileSystems, e.g. ext4, fat ..."
        select RT_USING_DFS_DISKFS

    config BSP_ROOTFS_TYPE_CROMFS
        bool "CROMFS"
        select RT_USING_DFS_CROMFS
        select PKG_USING_ZLIBq
        select PKG_USING_ZLIB_LATEST_VERSION
endchoice


# CVITEK Components Configuration
menuconfig CVI_COMPS_ENABLE
    bool "CVITEK Components"
    default y
    
if CVI_COMPS_ENABLE

    config CVI_OSDRV_ENABLE
        bool "Enable CVITEK OSDRV"
        default y

    config CVI_MPI_ENABLE
        bool "Enable CVITEK MPI"
        default y
        depends on CVI_OSDRV_ENABLE

    config CVI_MEDIA_PLAT_ENABLE
        bool "Enable CVITEK Media Platform"
        default y
        depends on CVI_MPI_ENABLE
        
endif
```

## rt-thread/components/cvi_comps/cvi_sns/Kconfig
```kconfig
menu "CVI Sensor Support List"
    config SENSOR_GCORE_GC2053
        int "GCORE GC2053"
        default 1
        
        
endmenu
```
